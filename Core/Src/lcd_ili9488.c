#include "lcd_ili9488.h"
#include "spi.h"
#include <string.h>
#include <stdio.h>

/* ---- Debug instrumentation (add to Keil watch window) ---- */
volatile uint32_t g_lcd_init_done  = 0;  /* 1 when LCD_Init() returns */
volatile uint32_t g_lcd_clear_done = 0;  /* 1 when first LCD_Clear() returns */
volatile uint32_t g_lcd_spi_calls  = 0;  /* total LCD_WriteByte() calls */
volatile uint32_t g_lcd_spi_err    = 0;  /* count of HAL_SPI_Transmit != HAL_OK */
volatile uint32_t g_lcd_last_st    = 0;  /* last HAL status: 0=OK 1=ERR 2=BUSY 3=TIMEOUT */

/* ---- GPIO pin map ---- */
#define LCD_CS_PORT    GPIOD
#define LCD_CS_PIN     GPIO_PIN_9
#define LCD_RST_PORT   GPIOD
#define LCD_RST_PIN    GPIO_PIN_10
#define LCD_DC_PORT    GPIOD
#define LCD_DC_PIN     GPIO_PIN_11
#define LCD_LED_PORT   GPIOD
#define LCD_LED_PIN    GPIO_PIN_12

#define LCD_CS_LOW()   HAL_GPIO_WritePin(LCD_CS_PORT,  LCD_CS_PIN,  GPIO_PIN_RESET)
#define LCD_CS_HIGH()  HAL_GPIO_WritePin(LCD_CS_PORT,  LCD_CS_PIN,  GPIO_PIN_SET)
#define LCD_DC_CMD()   HAL_GPIO_WritePin(LCD_DC_PORT,  LCD_DC_PIN,  GPIO_PIN_RESET)
#define LCD_DC_DATA()  HAL_GPIO_WritePin(LCD_DC_PORT,  LCD_DC_PIN,  GPIO_PIN_SET)

static void LCD_WriteByte(uint8_t b)
{
    g_lcd_spi_calls++;
    HAL_StatusTypeDef st = HAL_SPI_Transmit(&hspi2, &b, 1, 10);
    if (st != HAL_OK) {
        g_lcd_spi_err++;
        g_lcd_last_st = (uint32_t)st;
    }
}

static void LCD_WriteCmd(uint8_t cmd)
{
    LCD_DC_CMD();
    LCD_WriteByte(cmd);
}

static void LCD_WriteData(uint8_t dat)
{
    LCD_DC_DATA();
    LCD_WriteByte(dat);
}

static void LCD_WriteCmdData(uint8_t cmd, uint8_t dat)
{
    LCD_WriteCmd(cmd);
    LCD_WriteData(dat);
}

static void LCD_WriteColor(uint16_t c)
{
    // 16-bit RGB565 → 3 bytes (matching Arduino example ILI9488 format)
    LCD_WriteData((c >> 8) & 0xF8);
    LCD_WriteData((c >> 3) & 0xFC);
    LCD_WriteData(c << 3);
}

/* ---- Init sequence (from Arduino ILI9488 example) ---- */
void LCD_Init(void)
{
    // Hardware reset
    HAL_GPIO_WritePin(LCD_RST_PORT, LCD_RST_PIN, GPIO_PIN_SET);
    HAL_Delay(5);
    HAL_GPIO_WritePin(LCD_RST_PORT, LCD_RST_PIN, GPIO_PIN_RESET);
    HAL_Delay(15);
    HAL_GPIO_WritePin(LCD_RST_PORT, LCD_RST_PIN, GPIO_PIN_SET);
    HAL_Delay(15);

    LCD_CS_LOW();

    // COLMOD: 18-bit/pixel (matches Arduino's 3-byte color writes)
    // NOTE: official LCDWIKI demo sends 0x3A FIRST, before the register table.
    LCD_WriteCmd(0x3A);
    LCD_WriteData(0x66);

    // IMPORTANT: ILI9488 multi-parameter commands must send the command byte
    // ONCE (DC low) followed by ALL parameter bytes (DC high). Re-sending the
    // command resets the parameter index to 0, so the old LCD_WriteCmdData()
    // per-byte pattern only wrote param[0] of each register (VCOM 0xC5 was
    // corrupted -> all-white screen). Pattern below matches the official demo.
    LCD_WriteCmd(0xF7);                 // Adjust control 3
    LCD_WriteData(0xA9); LCD_WriteData(0x51); LCD_WriteData(0x2C); LCD_WriteData(0x82);

    LCD_WriteCmd(0xC0);                 // Power control 1
    LCD_WriteData(0x11); LCD_WriteData(0x09);

    LCD_WriteCmd(0xC1);                 // Power control 2
    LCD_WriteData(0x41);

    LCD_WriteCmd(0xC5);                 // VCOM control (critical for display)
    LCD_WriteData(0x00); LCD_WriteData(0x0A); LCD_WriteData(0x80);

    LCD_WriteCmd(0xB1);                 // Frame rate control
    LCD_WriteData(0xB0); LCD_WriteData(0x11);

    LCD_WriteCmd(0xB4);                 // Display inversion
    LCD_WriteData(0x02);

    LCD_WriteCmd(0xB6);                 // Display function control
    LCD_WriteData(0x02); LCD_WriteData(0x22);

    LCD_WriteCmd(0xB7);                 // Entry mode set
    LCD_WriteData(0xC6);

    LCD_WriteCmd(0xBE);                 // Adjust control 2
    LCD_WriteData(0x00); LCD_WriteData(0x04);

    LCD_WriteCmd(0xE9);                 // Set image function
    LCD_WriteData(0x00);

    // MADCTL: MY=1 MX=1 MV=0 ML=0 BGR=1 MH=0 (portrait 180° rotated)
    LCD_WriteCmd(0x36);
    LCD_WriteData(0xC8);

    // Positive gamma (0xE0)
    LCD_WriteCmd(0xE0);
    LCD_WriteData(0x00); LCD_WriteData(0x07); LCD_WriteData(0x10);
    LCD_WriteData(0x09); LCD_WriteData(0x17); LCD_WriteData(0x0B);
    LCD_WriteData(0x41); LCD_WriteData(0x89); LCD_WriteData(0x4B);
    LCD_WriteData(0x0A); LCD_WriteData(0x0C); LCD_WriteData(0x0E);
    LCD_WriteData(0x18); LCD_WriteData(0x1B); LCD_WriteData(0x0F);

    // Negative gamma (0xE1)
    LCD_WriteCmd(0xE1);
    LCD_WriteData(0x00); LCD_WriteData(0x17); LCD_WriteData(0x1A);
    LCD_WriteData(0x04); LCD_WriteData(0x0E); LCD_WriteData(0x06);
    LCD_WriteData(0x2F); LCD_WriteData(0x45); LCD_WriteData(0x43);
    LCD_WriteData(0x02); LCD_WriteData(0x0A); LCD_WriteData(0x09);
    LCD_WriteData(0x32); LCD_WriteData(0x36); LCD_WriteData(0x0F);

    LCD_WriteCmd(0x11);  // Exit Sleep
    HAL_Delay(120);
    LCD_WriteCmd(0x29);  // Display on

    LCD_CS_HIGH();

    // Backlight on
    HAL_GPIO_WritePin(LCD_LED_PORT, LCD_LED_PIN, GPIO_PIN_SET);

    g_lcd_init_done = 1;
}

/* ---- Set drawing window ---- */
void LCD_SetWindow(uint16_t x1, uint16_t y1, uint16_t x2, uint16_t y2)
{
    LCD_CS_LOW();

    LCD_WriteCmd(0x2A);  // Column address
    LCD_WriteData(x1 >> 8);
    LCD_WriteData(x1 & 0xFF);
    LCD_WriteData(x2 >> 8);
    LCD_WriteData(x2 & 0xFF);

    LCD_WriteCmd(0x2B);  // Page address
    LCD_WriteData(y1 >> 8);
    LCD_WriteData(y1 & 0xFF);
    LCD_WriteData(y2 >> 8);
    LCD_WriteData(y2 & 0xFF);

    LCD_WriteCmd(0x2C);  // Memory write start

    LCD_CS_HIGH();
}

/* ---- Clear screen ---- */
void LCD_Clear(uint16_t color)
{
    uint32_t n = (uint32_t)LCD_WIDTH * LCD_HEIGHT;
    LCD_CS_LOW();
    LCD_SetWindow(0, 0, LCD_WIDTH - 1, LCD_HEIGHT - 1);
    LCD_CS_LOW();  // SetWindow raised CS, bring it back
    LCD_DC_DATA();
    while (n--) {
        LCD_WriteByte((color >> 8) & 0xF8);
        LCD_WriteByte((color >> 3) & 0xFC);
        LCD_WriteByte(color << 3);
    }
    LCD_CS_HIGH();

    g_lcd_clear_done = 1;
}

/* ---- Fill rectangle ---- */
void LCD_FillRect(uint16_t x, uint16_t y, uint16_t w, uint16_t h, uint16_t color)
{
    uint32_t n = (uint32_t)w * h;
    LCD_CS_LOW();
    LCD_SetWindow(x, y, x + w - 1, y + h - 1);
    LCD_CS_LOW();
    LCD_DC_DATA();
    while (n--) {
        LCD_WriteByte((color >> 8) & 0xF8);
        LCD_WriteByte((color >> 3) & 0xFC);
        LCD_WriteByte(color << 3);
    }
    LCD_CS_HIGH();
}

/* ---- 8x16 ASCII font (subset: space, 0-9, :, A-Z, ., -, /, (, ), +) ---- */
/* Each char = 16 bytes (rows), MSB = leftmost pixel */
static const uint8_t font_8x16[44][16] = {
    // [0] ' ' (space)
    {0x00,0x00,0x00,0x00,0x00,0x00,0x00,0x00,
     0x00,0x00,0x00,0x00,0x00,0x00,0x00,0x00},
    // [1] '0'
    {0x7C,0xC6,0xC6,0xC6,0xC6,0xC6,0xC6,0xC6,
     0xC6,0xC6,0xC6,0xC6,0xC6,0xC6,0x7C,0x00},
    // [2] '1'
    {0x18,0x38,0x78,0x18,0x18,0x18,0x18,0x18,
     0x18,0x18,0x18,0x18,0x18,0x18,0x7E,0x00},
    // [3] '2'
    {0x7C,0xC6,0x06,0x06,0x06,0x0C,0x18,0x30,
     0x60,0x60,0xC0,0xC0,0xC0,0xC6,0xFE,0x00},
    // [4] '3'
    {0x7C,0xC6,0x06,0x06,0x06,0x06,0x3C,0x06,
     0x06,0x06,0x06,0x06,0x06,0xC6,0x7C,0x00},
    // [5] '4'
    {0x0C,0x1C,0x3C,0x6C,0xCC,0xCC,0xCC,0xCC,
     0xFE,0x0C,0x0C,0x0C,0x0C,0x0C,0x0C,0x00},
    // [6] '5'
    {0xFE,0xC0,0xC0,0xC0,0xC0,0xC0,0xFC,0x06,
     0x06,0x06,0x06,0x06,0x06,0xC6,0x7C,0x00},
    // [7] '6'
    {0x7C,0xC6,0xC0,0xC0,0xC0,0xC0,0xFC,0xC6,
     0xC6,0xC6,0xC6,0xC6,0xC6,0xC6,0x7C,0x00},
    // [8] '7'
    {0xFE,0xC6,0x06,0x06,0x06,0x0C,0x0C,0x0C,
     0x18,0x18,0x18,0x18,0x18,0x18,0x18,0x00},
    // [9] '8'
    {0x7C,0xC6,0xC6,0xC6,0xC6,0xC6,0x7C,0xC6,
     0xC6,0xC6,0xC6,0xC6,0xC6,0xC6,0x7C,0x00},
    // [10] '9'
    {0x7C,0xC6,0xC6,0xC6,0xC6,0xC6,0x7E,0x06,
     0x06,0x06,0x06,0x06,0x06,0xC6,0x7C,0x00},
    // [11] ':'
    {0x00,0x00,0x00,0x00,0x00,0x18,0x18,0x00,
     0x00,0x00,0x00,0x18,0x18,0x00,0x00,0x00},
    // [12] 'A'
    {0x10,0x38,0x6C,0xC6,0xC6,0xC6,0xC6,0xC6,
     0xFE,0xC6,0xC6,0xC6,0xC6,0xC6,0xC6,0x00},
    // [13] 'B'
    {0xFC,0xC6,0xC6,0xC6,0xC6,0xC6,0xFC,0xC6,
     0xC6,0xC6,0xC6,0xC6,0xC6,0xC6,0xFC,0x00},
    // [14] 'C'
    {0x7C,0xC6,0xC0,0xC0,0xC0,0xC0,0xC0,0xC0,
     0xC0,0xC0,0xC0,0xC0,0xC0,0xC6,0x7C,0x00},
    // [15] 'D'
    {0xF8,0xCC,0xC6,0xC6,0xC6,0xC6,0xC6,0xC6,
     0xC6,0xC6,0xC6,0xC6,0xC6,0xCC,0xF8,0x00},
    // [16] 'E'
    {0xFE,0xC0,0xC0,0xC0,0xC0,0xC0,0xFC,0xC0,
     0xC0,0xC0,0xC0,0xC0,0xC0,0xC0,0xFE,0x00},
    // [17] 'F'
    {0xFE,0xC0,0xC0,0xC0,0xC0,0xC0,0xFC,0xC0,
     0xC0,0xC0,0xC0,0xC0,0xC0,0xC0,0xC0,0x00},
    // [18] 'G'
    {0x7C,0xC6,0xC0,0xC0,0xC0,0xC0,0xCE,0xC6,
     0xC6,0xC6,0xC6,0xC6,0xC6,0xC6,0x7C,0x00},
    // [19] 'H'
    {0xC6,0xC6,0xC6,0xC6,0xC6,0xC6,0xFE,0xC6,
     0xC6,0xC6,0xC6,0xC6,0xC6,0xC6,0xC6,0x00},
    // [20] 'I'
    {0x7E,0x18,0x18,0x18,0x18,0x18,0x18,0x18,
     0x18,0x18,0x18,0x18,0x18,0x18,0x7E,0x00},
    // [21] 'J'
    {0x06,0x06,0x06,0x06,0x06,0x06,0x06,0x06,
     0x06,0x06,0x06,0x06,0xC6,0xC6,0x7C,0x00},
    // [22] 'K'
    {0xC6,0xC6,0xCC,0xD8,0xF0,0xE0,0xE0,0xF0,
     0xD8,0xCC,0xC6,0xC6,0xC6,0xC6,0xC6,0x00},
    // [23] 'L'
    {0xC0,0xC0,0xC0,0xC0,0xC0,0xC0,0xC0,0xC0,
     0xC0,0xC0,0xC0,0xC0,0xC0,0xC0,0xFE,0x00},
    // [24] 'M'
    {0xC6,0xEE,0xFE,0xD6,0xC6,0xC6,0xC6,0xC6,
     0xC6,0xC6,0xC6,0xC6,0xC6,0xC6,0xC6,0x00},
    // [25] 'N'
    {0xC6,0xC6,0xE6,0xE6,0xF6,0xF6,0xDE,0xCE,
     0xCE,0xC6,0xC6,0xC6,0xC6,0xC6,0xC6,0x00},
    // [26] 'O'
    {0x7C,0xC6,0xC6,0xC6,0xC6,0xC6,0xC6,0xC6,
     0xC6,0xC6,0xC6,0xC6,0xC6,0xC6,0x7C,0x00},
    // [27] 'P'
    {0xFC,0xC6,0xC6,0xC6,0xC6,0xC6,0xFC,0xC0,
     0xC0,0xC0,0xC0,0xC0,0xC0,0xC0,0xC0,0x00},
    // [28] 'Q'
    {0x7C,0xC6,0xC6,0xC6,0xC6,0xC6,0xC6,0xC6,
     0xC6,0xC6,0xC6,0xD6,0xCE,0xCC,0x76,0x00},
    // [29] 'R'
    {0xFC,0xC6,0xC6,0xC6,0xC6,0xC6,0xFC,0xF0,
     0xD8,0xCC,0xC6,0xC6,0xC6,0xC6,0xC6,0x00},
    // [30] 'S'
    {0x7C,0xC6,0xC0,0xC0,0xC0,0x60,0x38,0x0C,
     0x06,0x06,0x06,0x06,0x06,0xC6,0x7C,0x00},
    // [31] 'T'
    {0x7E,0x18,0x18,0x18,0x18,0x18,0x18,0x18,
     0x18,0x18,0x18,0x18,0x18,0x18,0x18,0x00},
    // [32] 'U'
    {0xC6,0xC6,0xC6,0xC6,0xC6,0xC6,0xC6,0xC6,
     0xC6,0xC6,0xC6,0xC6,0xC6,0xC6,0x7C,0x00},
    // [33] 'V'
    {0xC6,0xC6,0xC6,0xC6,0xC6,0xC6,0xC6,0xC6,
     0xC6,0xC6,0x6C,0x6C,0x38,0x38,0x10,0x00},
    // [34] 'W'
    {0xC6,0xC6,0xC6,0xC6,0xC6,0xC6,0xC6,0xC6,
     0xC6,0xC6,0xD6,0xD6,0xFE,0x6C,0x6C,0x00},
    // [35] 'X'
    {0xC6,0xC6,0x6C,0x6C,0x38,0x38,0x10,0x38,
     0x38,0x6C,0x6C,0xC6,0xC6,0xC6,0xC6,0x00},
    // [36] 'Y'
    {0x66,0x66,0x66,0x66,0x66,0x3C,0x18,0x18,
     0x18,0x18,0x18,0x18,0x18,0x18,0x18,0x00},
    // [37] 'Z'
    {0xFE,0xC6,0x06,0x06,0x0C,0x0C,0x18,0x18,
     0x30,0x30,0x60,0x60,0xC0,0xC0,0xFE,0x00},
    // [38] '.'
    {0x00,0x00,0x00,0x00,0x00,0x00,0x00,0x00,
     0x00,0x00,0x00,0x00,0x00,0x18,0x18,0x00},
    // [39] '-'
    {0x00,0x00,0x00,0x00,0x00,0x00,0xFE,0x00,
     0x00,0x00,0x00,0x00,0x00,0x00,0x00,0x00},
    // [40] '/'
    {0x02,0x06,0x06,0x0C,0x0C,0x0C,0x18,0x18,
     0x18,0x30,0x30,0x60,0x60,0x60,0xC0,0x00},
    // [41] '('
    {0x0C,0x18,0x30,0x30,0x60,0x60,0x60,0x60,
     0x60,0x60,0x60,0x30,0x30,0x18,0x0C,0x00},
    // [42] ')'
    {0x60,0x30,0x18,0x18,0x0C,0x0C,0x0C,0x0C,
     0x0C,0x0C,0x0C,0x18,0x18,0x30,0x60,0x00},
    // [43] '+'
    {0x00,0x00,0x18,0x18,0x18,0x18,0xFE,0x00,
     0xFE,0x18,0x18,0x18,0x18,0x00,0x00,0x00},
};

/* Map ASCII char → font index, returns -1 if not in subset */
static int font_index(char c)
{
    if (c == ' ') return 0;
    if (c >= '0' && c <= '9') return 1 + (c - '0');
    if (c == ':') return 11;
    if (c >= 'A' && c <= 'Z') return 12 + (c - 'A');
    if (c == '.') return 38;
    if (c == '-') return 39;
    if (c == '/') return 40;
    if (c == '(') return 41;
    if (c == ')') return 42;
    if (c == '+') return 43;
    return -1;  // not in font, will render as space
}

#define FONT_W 8
#define FONT_H 16

/* ---- Draw a single character at (x,y) ---- */
static void LCD_DrawChar(uint16_t x, uint16_t y, char c, uint16_t color, uint16_t bg)
{
    int idx = font_index(c);
    if (idx < 0) idx = 0;  // missing → space

    LCD_CS_LOW();
    LCD_SetWindow(x, y, x + FONT_W - 1, y + FONT_H - 1);
    LCD_CS_LOW();
    LCD_DC_DATA();

    for (int row = 0; row < FONT_H; row++) {
        uint8_t bits = font_8x16[idx][row];
        for (int col = 0; col < FONT_W; col++) {
            uint16_t c_out = (bits & 0x80) ? color : bg;
            LCD_WriteByte((c_out >> 8) & 0xF8);
            LCD_WriteByte((c_out >> 3) & 0xFC);
            LCD_WriteByte(c_out << 3);
            bits <<= 1;
        }
    }
    LCD_CS_HIGH();
}

/* ---- Print string at (x,y), no wrapping ---- */
void LCD_Print(uint16_t x, uint16_t y, const char *str, uint16_t color, uint16_t bg)
{
    while (*str) {
        LCD_DrawChar(x, y, *str++, color, bg);
        x += FONT_W + 1;  // 1px spacing
    }
}
